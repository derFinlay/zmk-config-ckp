## config/west.yml
```yaml
manifest:
  remotes:
    - name: zmkfirmware
      url-base: https://github.com/zmkfirmware
  projects:
    - name: zmk
      remote: zmkfirmware
      revision: 2adaa00d1092e41ce11dfae46ce7d2a5bad97ead
      import: app/west.yml
  self:
    path: config
```
